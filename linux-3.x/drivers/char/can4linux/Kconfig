## linux-3.x/drivers/char/can4linux/Kconfig
```kconfig
#
# FlexCAN device configuration
#
config FLEXCAN
	bool "Coldfire FlexCAN module support"
	depends on COLDFIRE
	help
	  Kernel-level support for the FlexCAN module that is a communication
	  controller implementing the controller area network (CAN) protocol,
	  an asynchronous communications protocol used in automotive and 
	  industrial control systems. It is a high speed (1 Mbit/sec), short
	  distance, priority based protocol which can communicate using a 
	  variety of mediums (for example, fiber optic cable or an unshielded
	  twisted pair of wires). The FlexCAN supports both the standard and
	  extended identifier (ID) message formats specified in the CAN protocol
	  specification, revision 2.0, part B. 

config FLEXCAN_CAN0
	tristate "CAN0"
	depends on ( FLEXCAN ) 
	help
	  Choose this option if you want to work with CAN0 port.
	  You can use one of port only (either CAN0 or CAN1).

config FLEXCAN_CAN1
	tristate "CAN1"
	depends on ( FLEXCAN )
	help
	  Choose this option if you want to work with CAN1 port.
	  You can use one of port only (either CAN0 or CAN1).
```

## linux-3.x/drivers/net/ethernet/p2001/Kconfig
```kconfig
#
# P2001 device configuration
#

config NET_VENDOR_P2001
        bool "P2001 ethernet devices"
        depends on (ARM && ARCH_P2001)
        ---help---
          If you have a network (Ethernet) card belonging to this class, say Y
          and read the Ethernet-HOWTO, available from
          <http://www.tldp.org/docs.html#howto>.

          Note that the answer to this question doesn't directly affect the
          kernel: saying N will just cause the configurator to skip all
          the questions about P2001 devices. If you say Y, you will be asked
	  for your specific card in the following questions.

if NET_VENDOR_P2001

config P2001_ETH
	tristate "P2001 ethernet driver"
	depends on ARM && ARCH_P2001
	select NET_CORE
	select MII
	help
	  P2001 ethernet driver

endif
```

## linux-3.x/drivers/net/ethernet/samsung/Kconfig
```kconfig
#
# Samsung device configuration
#

config NET_VENDOR_SAMSUNG
        bool "Samsung ethernet devices"
        depends on (ARM && ARCH_ESPD_4510B)
        ---help---
          If you have a network (Ethernet) card belonging to this class, say Y
          and read the Ethernet-HOWTO, available from
          <http://www.tldp.org/docs.html#howto>.

          Note that the answer to this question doesn't directly affect the
          kernel: saying N will just cause the configurator to skip all
          the questions about Samsung devices. If you say Y, you will be asked
	  for your specific card in the following questions.

if NET_VENDOR_SAMSUNG

config ARM_S3C4510B_ETH
	tristate "Samsung 4510B ethernet driver"
	depends on ARM && ARCH_ESPD_4510B
	select NET_CORE
	help
	  Samsung 4510B ethernet driver.

endif
```
